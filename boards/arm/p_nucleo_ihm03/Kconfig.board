## boards/arm/p_nucleo_ihm03/Kconfig.board
```kconfig
# Copyright (c) 2021 Teslabs Engineering S.L.
# SPDX-License-Identifier: Apache-2.0

config BOARD_P_NUCLEO_IHM03
	bool "P-NUCLEO-IHM03"
	depends on SOC_STM32G431XX
```
